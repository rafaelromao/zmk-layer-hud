## firmware/Kconfig
```kconfig
# Copyright (c) 2026 Rafael Romão
# SPDX-License-Identifier: MIT

# Kconfig functions split their arguments on commas, so the compatible (which
# contains one) must go through a variable first. Same pattern as ZMK itself.
DT_COMPAT_ZMK_LAYER_SIGNAL := zmk,layer-signal
DT_CHOSEN_ZMK_LAYER_HUD_UART := zmk,layer-hud-uart

config ZMK_LAYER_SIGNAL
    bool "Report the active layers to a host program"
    default $(dt_compat_enabled,$(DT_COMPAT_ZMK_LAYER_SIGNAL))
    depends on !ZMK_SPLIT || ZMK_SPLIT_ROLE_CENTRAL
    help
      On every layer change, send the set of active layers to a host program
      (zmk-layer-hud's hudfeed.py) as a small framed message on a carrier of
      this module's own: a CDC-ACM serial interface over USB, notifications on
      our own GATT service over BLE.

      Enabled automatically when a zmk,layer-signal node is present in the
      keymap. Only built on the central/unibody side, where the host is.

      Earlier versions smuggled the signal through the keyboard HID report as
      reserved keyboard-page usages. Linux maps that whole range to
      KEY_UNKNOWN, so every layer change arrived as a phantom key press
      carrying whatever modifiers were held, and a compositor could act on it.
      Nothing on these carriers can be read as a key, and the report type no
      longer matters -- the HKRO dependency this config used to carry is gone,
      as is the raised CONFIG_ZMK_HID_KEYBOARD_REPORT_SIZE it needed.

if ZMK_LAYER_SIGNAL

config ZMK_LAYER_SIGNAL_UART
    bool "Carry the signal on a CDC-ACM serial interface"
    default y if $(dt_chosen_enabled,$(DT_CHOSEN_ZMK_LAYER_HUD_UART))
    depends on SERIAL
    select UART_INTERRUPT_DRIVEN
    select RING_BUFFER
    help
      Needs a UART pointed at by the zmk,layer-hud-uart chosen node. The
      layer-hud-usb-uart snippet adds a cdc-acm-uart under zephyr_udc0 and sets
      that chosen, which is all most builds need:

        build ... -n layer-hud-usb-uart

      Interrupt-driven because the alternative, uart_poll_out, blocks on
      CDC-ACM once the host stops reading, and this module must never be able
      to delay a keystroke.

config ZMK_LAYER_SIGNAL_UART_TX_BUF
    int "Outgoing buffer for the serial carrier, in bytes"
    default 128
    depends on ZMK_LAYER_SIGNAL_UART
    help
      Frames are 11 bytes at most, so this holds a dozen of them. It only fills
      when the host is not reading, and a frame that does not fit is dropped:
      the next layer change or the heartbeat corrects the HUD, and dropping
      costs nothing a keystroke can feel. Raise it if you enable positions on a
      board that types faster than the host drains.

config ZMK_LAYER_SIGNAL_KEYS
    bool "Also send what is being typed"
    default y
    help
      On every keycode change, send a snapshot of the keyboard report's
      modifier byte and held usages. The HUD shows the characters you type from
      this, deriving them the same way it always has -- layout tables, dead-key
      composition -- because the snapshot is byte for byte what it used to read
      off the wire itself.

      Default y so the HUD behaves as it did when it read the HID report
      directly. Turning it off leaves layers (and positions, if enabled), which
      is enough for a HUD that only highlights keys, and stops the keyboard
      describing your keystrokes on a second interface.

config ZMK_LAYER_SIGNAL_GATT
    bool "Carry the signal as notifications on our own GATT service"
    default y
    depends on BT_PERIPHERAL
    help
      A primary service with one notify characteristic, beside ZMK's
      HID-over-GATT rather than inside it. Encryption is required to subscribe,
      so the signal only flows to a bonded host.

endif # ZMK_LAYER_SIGNAL

# Logging goes through ZMK's own log module (LOG_MODULE_DECLARE(zmk, ...)) and
# follows CONFIG_ZMK_LOG_LEVEL. Set CONFIG_ZMK_LOG_LEVEL_DBG=y to see frames.
```

## firmware/dts/bindings/zmk,layer-signal.yaml
```yaml
# Copyright (c) 2026 Rafael Romão
# SPDX-License-Identifier: MIT

description: |
  Reports the keyboard's active layers to a host program over a carrier of this
  module's own: a CDC-ACM serial interface over USB, notifications on our own
  GATT service over BLE. Nothing it sends can be read by the operating system
  as a key.

  On every layer change the module sends one frame carrying a bitmap of the
  active layers. With positions, it also sends one frame per key press and
  release. The frame format is in firmware/src/signal_frame.h, which the host
  mirrors.

  Example:

    / {
        layer_signal {
            compatible = "zmk,layer-signal";
            heartbeat-ms = <2000>;
            positions;
        };
    };

  Over USB the carrier needs a UART: build with the layer-hud-usb-uart snippet,
  which adds a cdc-acm-uart and points the zmk,layer-hud-uart chosen at it.

    build ... -n layer-hud-usb-uart

  Nothing needs to be set on the keyboard report any more. Earlier versions
  required CONFIG_ZMK_HID_KEYBOARD_REPORT_SIZE=12 and the HKRO report type
  because the signal shared the report with real keys; it no longer does.

compatible: "zmk,layer-signal"

properties:
  settle-ms:
    type: int
    default: 3
    description: |
      Delay between a layer change and the frame, so a group of changes (a host
      vim mode switching two layers, a layer-tap roll) becomes one frame.

  positions:
    type: boolean
    description: |
      Also send the physical position of every key press and release, so the
      HUD can light the exact key for chords, combos, macros, layer and
      modifier keys, whatever they produce.

      Safe to enable now. In the report-based version this cost two blocking
      HID sends per press on the system work queue -- the queue ZMK scans the
      matrix on -- which pushed the next press's timestamp past the combo term
      and stopped combos firing. The carriers here drop rather than block, so a
      press cannot be delayed by the signal.

  heartbeat-ms:
    type: int
    default: 0
    description: |
      When non-zero, re-send the current layer set this often, so a host that
      starts mid-session learns the state without a resync channel. 2000 is a
      good value for a HUD. 0 disables it.

      Unlike the report-based version this does not have to wait for held keys:
      that deferral existed because the old usages reached the host as key
      events and interrupted its auto-repeat.
```
